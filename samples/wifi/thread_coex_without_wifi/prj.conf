## CMakeLists.txt
```
#
# Copyright (c) 2023 Nordic Semiconductor ASA
#
# SPDX-License-Identifier: LicenseRef-Nordic-5-Clause
#

cmake_minimum_required(VERSION 3.20.0)
find_package(Zephyr REQUIRED HINTS $ENV{ZEPHYR_BASE})
project(nrf_wifi_thread_coex)

add_subdirectory(test)
target_sources(app PRIVATE
	src/thread_utils.c
	src/main.c
)
```

## Kconfig
```
#
# Copyright (c) 2023 Nordic Semiconductor
#
# SPDX-License-Identifier: LicenseRef-Nordic-5-Clause
#

source "Kconfig.zephyr"

menu "Nordic Coex sample"

#------------------------------ Thread configurations
config THREAD_ROLE_CLIENT
	bool "Thread device role"
	default y

config OT_CHANNEL
	int "Open thread operating channel"
	default 11

config OT_PAN_ID
	int "Open thread PAN ID"
	default 1

rsource "test/Kconfig"
endmenu
```

## sample.yaml
```
sample:
  description: Wi-Fi Thread coex sample
    application
  name: Wi-Fi Thread coex
tests:
  sample.nrf7002.thread_coex_sep_ant:
    build_only: true
    platform_allow: >
      nrf7002dk_nrf5340_cpuapp nrf5340dk_nrf5340_cpuapp nrf5340dk_nrf5340_cpuapp_ns nrf52840dk_nrf52840
      nrf52840dongle_nrf52840 nrf21540dk_nrf52840
    tags: ci_build
    extra_args: OVERLAY_CONFIG=overlay-ci.conf;overlay-multiprotocol.conf;overlay-tcp.conf
    integration_platforms:
      - nrf5340dk_nrf5340_cpuapp
      - nrf5340dk_nrf5340_cpuapp_ns
      - nrf52840dk_nrf52840
      - nrf52840dongle_nrf52840
      - nrf21540dk_nrf52840
```

## prj.conf
```kconfig
#
# Copyright (c) 2023 Nordic Semiconductor ASA
#
# SPDX-License-Identifier: LicenseRef-Nordic-5-Clause
#

CONFIG_WIFI=n
CONFIG_WIFI_NRF700X=n

# WPA supplicant
CONFIG_WPA_SUPP=y

# System settings
CONFIG_NEWLIB_LIBC=y
CONFIG_NEWLIB_LIBC_NANO=n

# Networking
CONFIG_NETWORKING=y
CONFIG_NET_SOCKETS=y
CONFIG_NET_LOG=y
CONFIG_NET_IPV4=y
CONFIG_NET_UDP=y
CONFIG_NET_TCP=y
CONFIG_NET_DHCPV4=y


CONFIG_NET_IF_UNICAST_IPV4_ADDR_COUNT=2
CONFIG_NET_MAX_CONTEXTS=8
CONFIG_NET_CONTEXT_SYNC_RECV=y

CONFIG_INIT_STACKS=y

CONFIG_NET_L2_ETHERNET=y

CONFIG_NET_CONFIG_SETTINGS=y
CONFIG_NET_CONFIG_INIT_TIMEOUT=0

#CONFIG_NET_SOCKETS_POLL_MAX=6

# Memories
CONFIG_MAIN_STACK_SIZE=4096
#CONFIG_SYSTEM_WORKQUEUE_STACK_SIZE=2048
CONFIG_NET_TX_STACK_SIZE=4096
CONFIG_NET_RX_STACK_SIZE=4096

# Debugging
CONFIG_STACK_SENTINEL=y
CONFIG_DEBUG_COREDUMP=y
CONFIG_DEBUG_COREDUMP_BACKEND_LOGGING=y
CONFIG_DEBUG_COREDUMP_MEMORY_DUMP_MIN=y

# Kernel options
CONFIG_ENTROPY_GENERATOR=y

# Logging
CONFIG_LOG=y
CONFIG_PRINTK=y
CONFIG_POSIX_CLOCK=y

# Benchmarking
CONFIG_NET_ZPERF=y
CONFIG_POSIX_MAX_FDS=16

# Optimized networking settings for performance
CONFIG_NET_TC_TX_COUNT=1
CONFIG_NET_PKT_RX_COUNT=16
CONFIG_NET_PKT_TX_COUNT=16
CONFIG_NET_BUF_RX_COUNT=16
CONFIG_NET_BUF_TX_COUNT=32
CONFIG_HEAP_MEM_POOL_SIZE=200000
CONFIG_NET_BUF_DATA_SIZE=1100

# Below configs need to be modified based on security
# CONFIG_STA_KEY_MGMT_NONE=y
# CONFIG_STA_KEY_MGMT_WPA2=y
# CONFIG_STA_KEY_MGMT_WPA2_256=y
# CONFIG_STA_KEY_MGMT_WPA3=y

CONFIG_NET_CONFIG_MY_IPV4_ADDR="192.168.1.99"
CONFIG_NET_CONFIG_MY_IPV4_NETMASK="255.255.255.0"
CONFIG_NET_CONFIG_MY_IPV4_GW="192.168.1.1"




CONFIG_DK_LIBRARY=y
CONFIG_DK_LIBRARY_DYNAMIC_BUTTON_HANDLERS=y
CONFIG_NRF700X_MAX_TX_PENDING_QLEN=12

CONFIG_COEX_TEST_DURATION=20000

#CONFIG_WPA_SUPP_LOG_LEVEL_DBG=y
CONFIG_THREAD_ROLE_CLIENT=y

CONFIG_NRF700X_QSPI_LOW_POWER=n
CONFIG_OT_CHANNEL=11
CONFIG_OT_PAN_ID=1
```

## src/main.c
```c
/**
 * Copyright (c) 2023 Nordic Semiconductor ASA
 *
 * SPDX-License-Identifier: LicenseRef-Nordic-5-Clause
 */

/** @file
 * @brief SR coexistence sample test bench
 */

#include <stdio.h>
#include <stdlib.h>
#include <string.h>
#include <stdbool.h>

#include "main.h"
#include <nrfx_clock.h>

#include <zephyr/logging/log.h>
#include "thread_utils.h"

LOG_MODULE_REGISTER(main, CONFIG_LOG_DEFAULT_LEVEL);

/* to check if the OT device role is as expected */
char* ot_state                   = "router"; /* set to "leader" or "router"*/
uint32_t ot_state_chk_iteration  = 0;
uint32_t total_duration_to_check = 60; /* seconds */
uint32_t time_gap_between_checks = 5; /* seconds */
uint32_t max_iterations          = 1;
uint32_t ret_strcmp              = 1; /* set to non-zero */
bool is_ot_state_matched         = false;
uint32_t test_idle_time          = 600; /* seconds */
int main(void)
{
	thread_throughput_test_init(false);
	
	/*k_sleep(K_SECONDS(3));*/
	
	/*LOG_INF("Waiting for OT discover to complete");*/
	/*while (1) {*/
		/*if (is_ot_discovery_done) {*/
			/*break;*/
		/*} */
	/*}*/
	/*LOG_INF("OT discover complete");*/

	/*[> check OT device state periodically until the expected state is found <]*/
	/*max_iterations = total_duration_to_check/time_gap_between_checks;	*/
	/*LOG_INF("Check OT device state for every %d seconds..", time_gap_between_checks);*/
	/*LOG_INF("until the expected state is found (or) timeout of %d seconds", total_duration_to_check);*/
	
	/*LOG_INF("OT device expected state %s", ot_state);*/
	/*while(1) {*/
		/*ot_state_chk_iteration++;*/
		/*[> LOG_INF("ot_state_chk_iteration: %d",ot_state_chk_iteration); <]*/
		/*ret_strcmp = strcmp(ot_state, check_ot_state());*/

		/*[> exit when OT device role matches the expected state (or) timeout <]*/
		/*if (ret_strcmp == 0) {*/
			/*is_ot_state_matched = true;*/
			/*break;*/
		/*}*/
		/*if (ot_state_chk_iteration >= max_iterations) {*/
			/*is_ot_state_matched = false;*/
			/*break;*/
		/*}*/
		/*k_sleep(K_SECONDS(time_gap_between_checks));	*/
	/*}	*/
	/*if (is_ot_state_matched == true) {*/
		/*LOG_INF("OT device state matched with the expected role");*/
	/*} else {*/
		/*LOG_ERR("OT device state NOT matched with the expected role");*/
	/*}*/

	/*k_sleep(K_SECONDS(3));*/
	/*thread_throughput_test_exit();*/
	/*LOG_INF("exiting the test after open thread discovery");*/

	return 0;
}
```

## src/main.h
```c
/*
 * Copyright (c) 2023 Nordic Semiconductor ASA
 *
 * SPDX-License-Identifier: LicenseRef-Nordic-5-Clause
 */

#ifndef MAIN_H_
#define MAIN_H_

#include <nrfx_clock.h>

#include <zephyr/kernel.h>
#include <zephyr/init.h>
#include <zephyr/device.h>
#include <zephyr/devicetree.h>
#include <zephyr/drivers/gpio.h>

#include <zephyr/shell/shell.h>
#include <zephyr/shell/shell_uart.h>

#include <zephyr/sys/byteorder.h>
#include <zephyr/net/zperf.h>
#include <zephyr/net/net_if.h>
#include <zephyr/net/wifi_mgmt.h>
#include <zephyr/net/net_event.h>
#include <zephyr/net/socket.h>


uint8_t is_ot_discovery_done;

#endif /* MAIN_H_ */
```

## src/thread_utils.c
```c
/*
 * Copyright (c) 2018 Nordic Semiconductor ASA
 *
 * SPDX-License-Identifier: LicenseRef-Nordic-5-Clause
 */

#include <assert.h>
#include <inttypes.h>
#include <string.h>
#include <stdlib.h>

#include "thread_utils.h"
#include "zephyr/net/openthread.h"

#include <zephyr/logging/log.h>

#include <openthread/config.h>
#include <openthread/cli.h>
#include <openthread/diag.h>
#include <openthread/error.h>
#include <openthread/link.h>
#include <openthread/platform/radio.h>
#include <openthread/tasklet.h>
#include <openthread/platform/logging.h>
#include <openthread/dataset_ftd.h>
#include <openthread/thread.h>

extern uint8_t is_ot_discovery_done;

static void setNetworkConfiguration(otInstance *aInstance) {
	static char          aNetworkName[] = "TestNetwork";
    otOperationalDataset aDataset;

    memset(&aDataset, 0, sizeof(otOperationalDataset));

    /*
     * Fields that can be configured in otOperationDataset to override defaults:
     *     Network Name, Mesh Local Prefix, Extended PAN ID, PAN ID, Delay Timer,
     *     Channel, Channel Mask Page 0, Network Key, PSKc, Security Policy
     */
    aDataset.mActiveTimestamp.mSeconds             = 1;
    aDataset.mActiveTimestamp.mTicks               = 0;
    aDataset.mActiveTimestamp.mAuthoritative       = false;
    aDataset.mComponents.mIsActiveTimestampPresent = true;

    /* Set Channel */
    aDataset.mChannel                      = 20;
    aDataset.mComponents.mIsChannelPresent = true;

    /* Set Pan ID */
    aDataset.mPanId                      = (otPanId)CONFIG_OT_PAN_ID;
    aDataset.mComponents.mIsPanIdPresent = true;

    /* Set Extended Pan ID */
    /* uint8_t extPanId[OT_EXT_PAN_ID_SIZE] = {0xC0, 0xDE, 0x1A, 0xB5, 0xC0, 0xDE, 0x1A, 0xB5}; */
    uint8_t extPanId[OT_EXT_PAN_ID_SIZE] = {0x11, 0x11, 0x11, 0x11, 0x11, 0x11, 0x11, 0x11};
    memcpy(aDataset.mExtendedPanId.m8, extPanId, sizeof(aDataset.mExtendedPanId));
    aDataset.mComponents.mIsExtendedPanIdPresent = true;

    /* Set network key */
    /* uint8_t key[OT_NETWORK_KEY_SIZE] = {0x12, 0x34, 0xC0, 0xDE, 0x1A, 0xB5, 0x12, 0x34, 0xC0, 0xDE, 0x1A, 0xB5, 0x12, 0x34, 0xC0, 0xDE}; */
    // uint8_t key[OT_NETWORK_KEY_SIZE] = {0x11, 0x11, 0x11, 0x11, 0x11, 0x11, 0x11, 0x11, 0x11, 0x11, 0x11, 0x11, 0x11, 0x11, 0x11, 0x11};
    uint8_t key[OT_NETWORK_KEY_SIZE] = {0x00, 0x11, 0x22, 0x33, 0x44, 0x55, 0x66, 0x77, 0x88, 0x99, 0xaa, 0xbb, 0xcc, 0xdd, 0xee, 0xff};

    memcpy(aDataset.mNetworkKey.m8, key, sizeof(aDataset.mNetworkKey));
    aDataset.mComponents.mIsNetworkKeyPresent = true;

    /* Set Network Name */
    size_t length = strlen(aNetworkName);
    assert(length <= OT_NETWORK_NAME_MAX_SIZE);
    memcpy(aDataset.mNetworkName.m8, aNetworkName, length);
    aDataset.mComponents.mIsNetworkNamePresent = true;

    otDatasetSetActive(aInstance, &aDataset);
}

LOG_MODULE_REGISTER(thread_utils, CONFIG_LOG_DEFAULT_LEVEL);

#define DEVICE_NAME	CONFIG_BT_DEVICE_NAME
#define DEVICE_NAME_LEN (sizeof(DEVICE_NAME) - 1)

extern uint8_t wait4_peer_thread2_start_connection;

int thread_throughput_test_run(void)
{

	return 0;
}

void handle_active_scan_result(struct otActiveScanResult *result, void *context) {
	if (!result) {
		return;
	}
	LOG_INF("------------------ FOUND NETWORK ------------------");
	LOG_INF("name: %-16s", result->mNetworkName.m8);
	LOG_INF("panid: %04x", result->mPanId);
	LOG_INF("channel: %2u", result->mChannel);
	LOG_INF("rssi: %3d", result->mRssi);
	LOG_INF("---------------------------------------------------");

	is_ot_discovery_done = 1;
}

int thread_throughput_test_init(bool is_thread_client)
{
	struct openthread_context *context = openthread_get_default_context();
	otInstance *instance = openthread_get_default_instance();
	LOG_INF("updating thread parameters");
	setNetworkConfiguration(instance);
	LOG_INF("enabling thread");
	otError err = openthread_start(context);	// 'ifconfig up && thread start'
	if (err != OT_ERROR_NONE) {
		LOG_ERR("starting openthread: %d (%s)", err, otThreadErrorToString(err));
	}
	/* otIp6SetEnabled(instance, true); */ /* cli `ifconfig up` */
	/* otThreadSetEnabled(instance, true); */ /* cli `thread start` */

	/*otDeviceRole current_role = otThreadGetDeviceRole(instance);*/
	/*LOG_INF("current role: %s", otThreadDeviceRoleToString(current_role));*/

	/*LOG_INF("performing discover");*/
	/*openthread_api_mutex_lock(context);*/
	/*otThreadDiscover(openthread_get_default_instance(), 0 [> all channels <],*/
		/*OT_PANID_BROADCAST, false, false, handle_active_scan_result, NULL);*/
	/*openthread_api_mutex_unlock(openthread_get_default_context());*/

	return 0;
}


const char* check_ot_state() {
	otDeviceRole current_role = otThreadGetDeviceRole(openthread_get_default_instance());
	/* LOG_INF("Current state: %s", otThreadDeviceRoleToString(current_role)); */
	return(otThreadDeviceRoleToString(current_role));
}

	
int thread_throughput_test_exit(void)
{
	openthread_api_mutex_lock(openthread_get_default_context());
	otThreadSetEnabled(openthread_get_default_instance(), false);
	otIp6SetEnabled(openthread_get_default_instance(), false);
	openthread_api_mutex_unlock(openthread_get_default_context());
	return 0;
}
```
