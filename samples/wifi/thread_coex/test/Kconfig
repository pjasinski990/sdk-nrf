## samples/wifi/thread_coex/test/Kconfig
```kconfig
#
# Copyright (c) 2023 Nordic Semiconductor
#
# SPDX-License-Identifier: LicenseRef-Nordic-5-Clause
#

menu "Nordic Coex sample - test"

#-------------------------------------- test parameters
choice TEST_TYPE
	prompt "Test type"
	default TEST_TYPE_WLAN_OT

config TEST_TYPE_WLAN_ONLY
	bool "WLAN only"
	help
	  Enable WLAN only

config TEST_TYPE_OT_ONLY
	bool "OT only"
	help
	  Enable OT only

config TEST_TYPE_WLAN_OT
	bool "WLAN and BLE"
	help
	  Enable WLAN and BLE
endchoice

config TEST_TYPE_WLAN
	bool "WLAN"
	default y if TEST_TYPE_WLAN_ONLY || TEST_TYPE_WLAN_OT
	select WIFI
	help
	  Enable WLAN

config TEST_TYPE_OT
	bool "Thread"
	default y if TEST_TYPE_OT_ONLY || TEST_TYPE_WLAN_OT
	help
	  Enable Thread

config OT_EXTERNAL_ANTENNA
	bool "Indicates if external antenna used for BT"
	default n

config COEX_TEST_DURATION
	int "test duration in milliseconds"
	default 20000

config COEX_SEP_ANTENNAS
	bool "Control if the antennas are shared/serparate for Thread and WLAN"
	default y

config DEBUG_PRINT_WIFI_SCAN_INFO
	bool "Print Wi-Fi Scan info for debug purpose"
	default n

config DEBUG_PRINT_WIFI_DHCP_INFO
	bool "Print Wi-Fi DHCP info for debug purpose"
	default n

config DEBUG_PRINT_WIFI_CONN_INFO
	bool "Print Wi-Fi Connection info for debug purpose"
	default n

config PRINTS_FOR_AUTOMATION
	bool "Print info required for automation"
	default y

#----------------------------------- system tests
#===================================================== thread tests	start  
config WIFI_SCAN_OT_DISCOV
	bool "Indicates test is to be run or not"
	default n
config WIFI_CON_SCAN_OT_DISCOV
	bool "Indicates test is to be run or not"
	default n
config WIFI_TP_UDP_CLIENT_OT_DISCOV
	bool "Indicates test is to be run or not"
	default n
config WIFI_TP_TCP_CLIENT_OT_DISCOV
	bool "Indicates test is to be run or not"
	default n
config WIFI_TP_UDP_SERVER_OT_DISCOV
	bool "Indicates test is to be run or not"
	default n
config WIFI_TP_TCP_SERVER_OT_DISCOV
	bool "Indicates test is to be run or not"
	default n
#===================================================== thread tests	end  
config WIFI_SCAN_BLE_CON_CENTRAL
	bool "Indicates test is to be run or not"
	default n

config WIFI_SCAN_BLE_CON_PERIPH
	bool "Indicates test is to be run or not"
	default n

config WIFI_SCAN_BLE_TP_CENTRAL
	bool "Indicates test is to be run or not"
	default n

config WIFI_SCAN_BLE_TP_PERIPH
	bool "Indicates test is to be run or not"
	default n

config WIFI_CON_SCAN_BLE_CON_CENTRAL
	bool "Indicates test is to be run or not"
	default n

config WIFI_CON_SCAN_BLE_CON_PERIPH
	bool "Indicates test is to be run or not"
	default n

config WIFI_CON_SCAN_BLE_TP_CENTRAL
	bool "Indicates test is to be run or not"
	default n

config WIFI_CON_SCAN_BLE_TP_PERIPH
	bool "Indicates test is to be run or not"
	default n

config WIFI_CON_BLE_CON_CENTRAL
	bool "Indicates test is to be run or not"
	default n

config WIFI_CON_BLE_CON_PERIPH
	bool "Indicates test is to be run or not"
	default n

config WIFI_CON_BLE_TP_CENTRAL
	bool "Indicates test is to be run or not"
	default n

config WIFI_CON_BLE_TP_PERIPH
	bool "Indicates test is to be run or not"
	default n

config WIFI_TP_UDP_CLIENT_BLE_CON_CENTRAL
	bool "Indicates test is to be run or not"
	default n

config WIFI_TP_UDP_CLIENT_BLE_CON_PERIPH
	bool "Indicates test is to be run or not"
	default n

config WIFI_TP_UDP_CLIENT_BLE_TP_CENTRAL
	bool "Indicates test is to be run or not"
	default n

config WIFI_TP_UDP_CLIENT_BLE_TP_PERIPH
	bool "Indicates test is to be run or not"
	default n

config WIFI_TP_UDP_SERVER_BLE_CON_CENTRAL
	bool "Indicates test is to be run or not"
	default n

config WIFI_TP_UDP_SERVER_BLE_CON_PERIPH
	bool "Indicates test is to be run or not"
	default n

config WIFI_TP_UDP_SERVER_BLE_TP_CENTRAL
	bool "Indicates test is to be run or not"
	default n

config WIFI_TP_UDP_SERVER_BLE_TP_PERIPH
	bool "Indicates test is to be run or not"
	default n

config WIFI_TP_TCP_CLIENT_BLE_CON_CENTRAL
	bool "Indicates test is to be run or not"
	default n

config WIFI_TP_TCP_CLIENT_BLE_CON_PERIPH
	bool "Indicates test is to be run or not"
	default n

config WIFI_TP_TCP_CLIENT_BLE_TP_CENTRAL
	bool "Indicates test is to be run or not"
	default n

config WIFI_TP_TCP_CLIENT_BLE_TP_PERIPH
	bool "Indicates test is to be run or not"
	default n

config WIFI_TP_TCP_SERVER_BLE_CON_CENTRAL
	bool "Indicates test is to be run or not"
	default n

config WIFI_TP_TCP_SERVER_BLE_CON_PERIPH
	bool "Indicates test is to be run or not"
	default n

config WIFI_TP_TCP_SERVER_BLE_TP_CENTRAL
	bool "Indicates test is to be run or not"
	default n

config WIFI_TP_TCP_SERVER_BLE_TP_PERIPH
	bool "Indicates test is to be run or not"
	default n
#----------------------------------- stability tests
config WIFI_CON_BLE_CON_CENTRAL_STABILITY
	bool "Indicates test is to be run or not"
	default n

config WIFI_CON_BLE_CON_PERIPH_STABILITY
	bool "Indicates test is to be run or not"
	default n

config WIFI_CON_BLE_TP_CENTRAL_STABILITY
	bool "Indicates test is to be run or not"
	default n

config WIFI_CON_BLE_TP_PERIPH_STABILITY
	bool "Indicates test is to be run or not"
	default n
#-----------
config BLE_CONN_CENTRAL_WIFI_SCAN_STABILITY
	bool "Indicates test is to be run or not"
	default n
config BLE_CONN_CENTRAL_WIFI_CON_SCAN_STABILITY
	bool "Indicates test is to be run or not"
	default n
config BLE_CONN_CENTRAL_WIFI_CON_STABILITY
	bool "Indicates test is to be run or not"
	default n
config BLE_CONN_CENTRAL_WIFI_PING_STABILITY
	bool "Indicates test is to be run or not"
	default n
config BLE_CONN_CENTRAL_WIFI_TP_UDP_CLIENT_STABILITY
	bool "Indicates test is to be run or not"
	default n
config BLE_CONN_CENTRAL_WIFI_TP_UDP_SERVER_STABILITY
	bool "Indicates test is to be run or not"
	default n
config BLE_CONN_CENTRAL_WIFI_TP_TCP_CLIENT_STABILITY
	bool "Indicates test is to be run or not"
	default n
config BLE_CONN_CENTRAL_WIFI_TP_TCP_SERVER_STABILITY
	bool "Indicates test is to be run or not"
	default n
#-----------
config BLE_CONN_PERIPHERAL_WIFI_SCAN_STABILITY
	bool "Indicates test is to be run or not"
	default n
config BLE_CONN_PERIPHERAL_WIFI_CON_SCAN_STABILITY
	bool "Indicates test is to be run or not"
	default n
config BLE_CONN_PERIPHERAL_WIFI_CON_STABILITY
	bool "Indicates test is to be run or not"
	default n
config BLE_CONN_PERIPHERAL_WIFI_PING_STABILITY
	bool "Indicates test is to be run or not"
	default n
config BLE_CONN_PERIPHERAL_WIFI_TP_UDP_CLIENT_STABILITY
	bool "Indicates test is to be run or not"
	default n
config BLE_CONN_PERIPHERAL_WIFI_TP_UDP_SERVER_STABILITY
	bool "Indicates test is to be run or not"
	default n
config BLE_CONN_PERIPHERAL_WIFI_TP_TCP_CLIENT_STABILITY
	bool "Indicates test is to be run or not"
	default n
config BLE_CONN_PERIPHERAL_WIFI_TP_TCP_SERVER_STABILITY
	bool "Indicates test is to be run or not"
	default n
#----------------------------------- Wi-Fi shutdown tests
config BLE_CON_CENTRAL_WIFI_SHUTDOWN
	bool "Indicates test is to be run or not"
	default n
config BLE_CON_PERIPHERAL_WIFI_SHUTDOWN
	bool "Indicates test is to be run or not"
	default n
config BLE_TP_CENTRAL_WIFI_SHUTDOWN
	bool "Indicates test is to be run or not"
	default n
config BLE_TP_PERIPH_WIFI_SHUTDOWN
	bool "Indicates test is to be run or not"
	default n
#-------------------------------- Test groups
config RUN_SPT_TESTS
	bool "Indicates test is to be run or not"
	default n
config RUN_ST_TESTS
	bool "Indicates test is to be run or not"
	default n
config RUN_WST_TESTS
	bool "Indicates test is to be run or not"
	default n
endmenu
```
