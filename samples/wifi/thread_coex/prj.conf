## CMakeLists.txt
```
#
# Copyright (c) 2023 Nordic Semiconductor ASA
#
# SPDX-License-Identifier: LicenseRef-Nordic-5-Clause
#

cmake_minimum_required(VERSION 3.20.0)

set(DTC_OVERLAY_FILE "dts.overlay")

find_package(Zephyr REQUIRED HINTS $ENV{ZEPHYR_BASE})
project(nrf_wifi_thread_coex)

add_subdirectory(test)
target_sources(app PRIVATE
	src/ot_utils.c
	src/wifi_utils.c
	src/ot_coex_functions.c
	src/main.c
)

# For net_private.h
target_include_directories(app PUBLIC
	${ZEPHYR_BASE}/subsys/net/ip
)

#zephyr_library_include_directories(${ZEPHYR_BASE}/samples/openthread)
```

## Kconfig
```
#
# Copyright (c) 2023 Nordic Semiconductor
#
# SPDX-License-Identifier: LicenseRef-Nordic-5-Clause
#

source "Kconfig.zephyr"

menu "Nordic Coex sample"

#------------------------------ Wi-Fi configurations
config STA_SSID
	string "SSID"
	default "wifi_sr_coex_24"
	help
	  Specify the SSID to connect

choice  STA_KEY_MGMT_SELECT
	prompt "Security Option"
	default STA_KEY_MGMT_NONE

config STA_KEY_MGMT_NONE
	bool "Open Security"
	help
	  Enable for Open Security

config STA_KEY_MGMT_WPA2
	bool "WPA2 Security"
	help
	  Enable for WPA2 Security

config STA_KEY_MGMT_WPA2_256
	bool "WPA2 SHA 256 Security"
	help
	  Enable for WPA2-PSK-256 Security

config STA_KEY_MGMT_WPA3
	bool "WPA3 Security"
	help
	  Enable for WPA3 Security
endchoice

config STA_PASSWORD
	string "Passphrase (WPA2) or password (WPA3)"
	help
	  Specify the Password to connect

config NET_CONFIG_PEER_IPV4_ADDR
	string "Peer IPv4 address"
	default "192.168.1.253"

config NET_CONFIG_PEER_IPV4_PORT
	int "Peer IPv4 port"
	default 5001

config WIFI_THREAD_STACK_SIZE
	int "Wi-Fi thread stack size"
	default 4096

config WIFI_THREAD_PRIORITY
	int "Wi-Fi thread priority"
	default 5

config WIFI_ZPERF_SERVER
	bool "Zperf role: server or client"
	default n

config WIFI_ZPERF_PROT_UDP
	bool "UDP or TCP"
	default y

config WIFI_ZPERF_PKT_SIZE
	int "packet size"
	default 1024

config WIFI_ZPERF_RATE
	int "rate in kbps"
	default 15000

config WIFI_BAND_2PT4G
	bool "Indicates if WLAN operating band is 2.4GHz or 5GHz"
	default y

config OT_TX_PWR_CTRL_RSSI
	bool "Enable TX power control for Thread"
	default n

#------------------------------ Wi-Fi TWT configurations
config CONNECTION_IDLE_TIMEOUT
	int "Time to be waited for a station to connect"
	default 30

config TWT_TRIGGER_ENABLE
	bool "Enable trigger mode"
	help
	  STA expects AP to send triggers for start of every service period.
	default y

config TWT_ANNOUNCED_MODE
	bool "Enable announced mode"
	help
	  STA announces its wakeup to AP for every service period start.
	default y

config TWT_WAKE_INTERVAL
	int "TWT awake interval"
	help
	  The period where STA is awake and does data transfer, interval should be in us.
	default 256000

config TWT_INTERVAL
	int "TWT service interval"
	help
	  The period for TWT that includes both wake and sleep durations, interval should be in us.
	  Please note higher intervals can be rejected by AP or cause interoperability issues.
	default 524000

config TWT_ENABLE
	bool "Indicates test is to be run or not"
	default n

#------------------------------ Thread configurations
config OT_CHANNEL
	int "Open thread operating channel"
	default 18

config OT_PAN_ID
	int "Open thread PAN ID"
	default 1

config OT_ROLE_CLIENT
	bool "Thread device role"
	default y

rsource "test/Kconfig"
endmenu
```

## prj.conf
```kconfig
#
# Copyright (c) 2023 Nordic Semiconductor ASA
#
# SPDX-License-Identifier: LicenseRef-Nordic-5-Clause
#

CONFIG_WIFI=y
CONFIG_WIFI_NRF700X=y

# WPA supplicant
CONFIG_WPA_SUPP=y

# System settings
CONFIG_NEWLIB_LIBC=y
CONFIG_NEWLIB_LIBC_NANO=n

# Networking
CONFIG_NETWORKING=y
CONFIG_NET_SOCKETS=y
CONFIG_NET_LOG=y
CONFIG_NET_IPV4=y
CONFIG_NET_UDP=y
CONFIG_NET_TCP=y
CONFIG_NET_DHCPV4=y


CONFIG_NET_IF_UNICAST_IPV4_ADDR_COUNT=2
CONFIG_NET_MAX_CONTEXTS=8
CONFIG_NET_CONTEXT_SYNC_RECV=y

CONFIG_INIT_STACKS=y

CONFIG_NET_L2_ETHERNET=y

CONFIG_NET_CONFIG_SETTINGS=y
CONFIG_NET_CONFIG_INIT_TIMEOUT=0



# Memories
CONFIG_MAIN_STACK_SIZE=4096
CONFIG_NET_TX_STACK_SIZE=4096
CONFIG_NET_RX_STACK_SIZE=4096

# Debugging
CONFIG_STACK_SENTINEL=y
CONFIG_DEBUG_COREDUMP=y
CONFIG_DEBUG_COREDUMP_BACKEND_LOGGING=y
CONFIG_DEBUG_COREDUMP_MEMORY_DUMP_MIN=y

# Kernel options
CONFIG_ENTROPY_GENERATOR=y

# Logging
CONFIG_LOG=y
CONFIG_PRINTK=y
CONFIG_POSIX_CLOCK=y

# Benchmarking
CONFIG_NET_ZPERF=y
CONFIG_POSIX_MAX_FDS=16

# Optimized networking settings for performance
CONFIG_NET_TC_TX_COUNT=1
CONFIG_NET_PKT_RX_COUNT=4
CONFIG_NET_PKT_TX_COUNT=12
CONFIG_NET_BUF_RX_COUNT=4
CONFIG_NET_BUF_TX_COUNT=24
CONFIG_HEAP_MEM_POOL_SIZE=200000
CONFIG_NET_BUF_DATA_SIZE=1100

# Below configs need to be modified based on security
# CONFIG_STA_KEY_MGMT_NONE=y
# CONFIG_STA_KEY_MGMT_WPA2=y
# CONFIG_STA_KEY_MGMT_WPA2_256=y
# CONFIG_STA_KEY_MGMT_WPA3=y
CONFIG_STA_SSID="wifi_sr_coex_24"
CONFIG_STA_PASSWORD="Mypassword"

CONFIG_NET_CONFIG_MY_IPV4_ADDR="192.168.1.99"
CONFIG_NET_CONFIG_MY_IPV4_NETMASK="255.255.255.0"
CONFIG_NET_CONFIG_MY_IPV4_GW="192.168.1.1"

# DUT zperf configuration
CONFIG_WIFI_ZPERF_PROT_UDP=y
CONFIG_WIFI_ZPERF_PKT_SIZE=1024
CONFIG_WIFI_ZPERF_RATE=15000
CONFIG_WIFI_ZPERF_SERVER=n

CONFIG_BT_DEVICE_NAME="Nordic_Throughput"
CONFIG_BT=y
CONFIG_BT_SMP=y
CONFIG_BT_PERIPHERAL=y
CONFIG_BT_CENTRAL=y
CONFIG_BT_MAX_CONN=2

CONFIG_BT_SCAN=y
CONFIG_BT_SCAN_FILTER_ENABLE=y
CONFIG_BT_SCAN_UUID_CNT=1

CONFIG_BT_GATT_CLIENT=y
CONFIG_BT_GATT_DM=y
CONFIG_BT_THROUGHPUT=y

CONFIG_BT_USER_DATA_LEN_UPDATE=y
CONFIG_BT_USER_PHY_UPDATE=y
CONFIG_BT_GAP_AUTO_UPDATE_CONN_PARAMS=n

CONFIG_BT_BUF_ACL_RX_SIZE=502
CONFIG_BT_ATT_PREPARE_COUNT=2
CONFIG_BT_CONN_TX_MAX=10
CONFIG_BT_L2CAP_TX_BUF_COUNT=10
CONFIG_BT_L2CAP_TX_MTU=498
CONFIG_BT_BUF_ACL_TX_SIZE=502
CONFIG_BT_L2CAP_DYNAMIC_CHANNEL=y
CONFIG_DK_LIBRARY=y
CONFIG_DK_LIBRARY_DYNAMIC_BUTTON_HANDLERS=y

CONFIG_NRF700X_MAX_TX_PENDING_QLEN=12
CONFIG_OT_EXTERNAL_ANTENNA=n
CONFIG_COEX_TEST_DURATION=60000

#CONFIG_WPA_SUPP_LOG_LEVEL_DBG=y

#--------------------------- TWT
# these two are commented as default in TWT module
CONFIG_TWT_TRIGGER_ENABLE=n
CONFIG_TWT_ANNOUNCED_MODE=n

# set to 2 as default as part of sr_coex. So commented here.
#CONFIG_NET_IF_UNICAST_IPV4_ADDR_COUNT=1
# set to 8 as default as default as part of sr_coex. So commented here.
#CONFIG_NET_MAX_CONTEXTS=5

#CONFIG_PM=y
CONFIG_LOG_BUFFER_SIZE=2048
CONFIG_NET_MGMT_EVENT_QUEUE_TIMEOUT=5000

CONFIG_TWT_ENABLE=n
CONFIG_TWT_TRIGGER_ENABLE=n
CONFIG_TWT_ANNOUNCED_MODE=n
CONFIG_NRF_WIFI_LOW_POWER=y

CONFIG_BT_GAP_ADV_FAST_INT_MIN_2=160
CONFIG_BT_GAP_ADV_FAST_INT_MAX_2=240
CONFIG_BT_LE_SCAN_INTERVAL=16
CONFIG_BT_LE_SCAN_WINDOW=16
CONFIG_BLE_INTERVAL_MIN=80
CONFIG_BLE_INTERVAL_MAX=80
CONFIG_BT_SUPERVISION_TIMEOUT=1000
CONFIG_BT_CONN_LATENCY=0
CONFIG_NRF700X_QSPI_LOW_POWER=n


CONFIG_THREAD_ROLE_CLIENT=y
CONFIG_OT_CHANNEL=11
CONFIG_OT_PAN_ID=1
```

## overlay-openthread.conf
```kconfig
CONFIG_NETWORKING=y
CONFIG_NET_L2_OPENTHREAD=y
CONFIG_OPENTHREAD_NORDIC_LIBRARY_MASTER=y
CONFIG_NET_IF_MAX_IPV6_COUNT=2
```

## src/main.c
```c
/**
 * Copyright (c) 2023 Nordic Semiconductor ASA
 *
 * SPDX-License-Identifier: LicenseRef-Nordic-5-Clause
 */

#include "main.h"

int main(void)
{
	int ret = 0;
	bool is_ant_mode_sep = IS_ENABLED(CONFIG_COEX_SEP_ANTENNAS);
	bool is_ot_client = IS_ENABLED(CONFIG_OT_ROLE_CLIENT);
	bool is_wifi_server = IS_ENABLED(CONFIG_WIFI_ZPERF_SERVER);
	bool is_wifi_zperf_udp = IS_ENABLED(CONFIG_WIFI_ZPERF_PROT_UDP);
	bool test_wifi = IS_ENABLED(CONFIG_TEST_TYPE_WLAN);
	bool test_thread = IS_ENABLED(CONFIG_TEST_TYPE_OT);

#if defined(CONFIG_BOARD_NRF7002DK_NRF7001_NRF5340_CPUAPP) || \
	defined(CONFIG_BOARD_NRF7002DK_NRF5340_CPUAPP)
	bool ot_external_antenna = IS_ENABLED(CONFIG_OT_EXTERNAL_ANTENNA);
#endif

	bool is_wifi_conn_scan =
		IS_ENABLED(CONFIG_WIFI_CON_SCAN_OT_DISCOV) ||
		IS_ENABLED(CONFIG_WIFI_CON_SCAN_OT_CONNECTION) ||
		IS_ENABLED(CONFIG_WIFI_CON_SCAN_OT_TP_CLIENT) ||
		IS_ENABLED(CONFIG_WIFI_CON_SCAN_OT_TP_SERVER) ||
		IS_ENABLED(CONFIG_OT_CON_STABILITY_WIFI_CON_SCAN_INTERFERENCE);

#if !defined(CONFIG_COEX_SEP_ANTENNAS) && \
	!(defined(CONFIG_BOARD_NRF7002DK_NRF7001_NRF5340_CPUAPP) || \
	defined(CONFIG_BOARD_NRF7002DK_NRF5340_CPUAPP))
	BUILD_ASSERT("Shared antenna support is not available with nRF7002 shields");
#endif

	/* register callback functions etc */
	wifi_init();	

#if defined(CONFIG_BOARD_NRF7002DK_NRF7001_NRF5340_CPUAPP) || \
	defined(CONFIG_BOARD_NRF7002DK_NRF5340_CPUAPP)
#if defined(CONFIG_NRF700X_BT_COEX)
		/* Configure SR side (nRF5340 side) switch in nRF7x */
		LOG_INF("Configure SR side switch");
		ret = nrf_wifi_config_sr_switch(is_ant_mode_sep, ot_external_antenna);
		if (ret != 0) {
			LOG_ERR("Unable to configure SR side switch: %d", ret);
			goto err;
		}
#endif /* CONFIG_NRF700X_BT_COEX */
#endif

#if defined(CONFIG_NRF700X_BT_COEX)
	/* Configure non-PTA registers of Coexistence Hardware */
	LOG_INF("Configuring non-PTA registers.");
	ret = nrf_wifi_coex_config_non_pta(is_ant_mode_sep);
	if (ret != 0) {
		LOG_ERR("Configuring non-PTA registers of CoexHardware FAIL");
		goto err;
	}
#endif /* CONFIG_NRF700X_BT_COEX */

	if (IS_ENABLED(CONFIG_WIFI_SCAN_OT_DISCOV) ||
	IS_ENABLED(CONFIG_WIFI_CON_SCAN_OT_DISCOV)) {
		ret = wifi_scan_ot_discov(is_ant_mode_sep, test_thread, test_wifi,
		is_ot_client, is_wifi_conn_scan);
	}

	if (IS_ENABLED(CONFIG_WIFI_SCAN_OT_CONNECTION) ||
	IS_ENABLED(CONFIG_WIFI_CON_SCAN_OT_CONNECTION)) {
		ret = wifi_scan_ot_connection(is_ant_mode_sep, test_thread, test_wifi,
		is_ot_client, is_wifi_conn_scan);
	}
	
	if (IS_ENABLED(CONFIG_WIFI_SCAN_OT_TP_CLIENT) ||
	IS_ENABLED(CONFIG_WIFI_CON_SCAN_OT_TP_CLIENT) ||
	IS_ENABLED(CONFIG_WIFI_SCAN_OT_TP_SERVER) ||
	IS_ENABLED(CONFIG_WIFI_CON_SCAN_OT_TP_SERVER)) {
		ret = wifi_scan_ot_tput(is_ant_mode_sep, test_thread, test_wifi,
		is_ot_client, is_wifi_conn_scan);
	}

	if (IS_ENABLED(CONFIG_WIFI_CON_OT_DISCOV)) {
		ret = wifi_con_ot_discov(test_wifi, is_ant_mode_sep, test_thread, is_ot_client);
	}

	if (IS_ENABLED(CONFIG_WIFI_CON_OT_TP_CLIENT) ||
	IS_ENABLED(CONFIG_WIFI_CON_OT_TP_SERVER)) {
		ret = wifi_con_ot_tput(test_wifi, is_ant_mode_sep, test_thread, is_ot_client);
	}

	if (IS_ENABLED(CONFIG_WIFI_TP_UDP_CLIENT_OT_DISCOV) ||
	IS_ENABLED(CONFIG_WIFI_TP_TCP_CLIENT_OT_DISCOV) ||
	IS_ENABLED(CONFIG_WIFI_TP_UDP_SERVER_OT_DISCOV) ||
	IS_ENABLED(CONFIG_WIFI_TP_TCP_SERVER_OT_DISCOV)) {
		ret = wifi_tput_ot_discov(test_wifi, test_thread, is_ot_client,
		is_wifi_server, is_ant_mode_sep, is_wifi_zperf_udp);
	}

	if (IS_ENABLED(CONFIG_WIFI_TP_UDP_CLIENT_OT_CONNECTION) ||
	IS_ENABLED(CONFIG_WIFI_TP_TCP_CLIENT_OT_CONNECTION) ||
	IS_ENABLED(CONFIG_WIFI_TP_UDP_SERVER_OT_CONNECTION) ||
	IS_ENABLED(CONFIG_WIFI_TP_TCP_SERVER_OT_CONNECTION)) {
		ret = wifi_tput_ot_connection(test_wifi, test_thread, is_ot_client,
		is_wifi_server, is_ant_mode_sep, is_wifi_zperf_udp);
	}
	
	if (IS_ENABLED(CONFIG_WIFI_TP_UDP_CLIENT_OT_TP_CLIENT) ||
	IS_ENABLED(CONFIG_WIFI_TP_TCP_CLIENT_OT_TP_CLIENT) ||
	IS_ENABLED(CONFIG_WIFI_TP_UDP_CLIENT_OT_TP_SERVER) ||
	IS_ENABLED(CONFIG_WIFI_TP_TCP_CLIENT_OT_TP_SERVER) ||
	IS_ENABLED(CONFIG_WIFI_TP_UDP_SERVER_OT_TP_CLIENT) ||
	IS_ENABLED(CONFIG_WIFI_TP_TCP_SERVER_OT_TP_CLIENT) ||
	IS_ENABLED(CONFIG_WIFI_TP_UDP_SERVER_OT_TP_SERVER) ||
	IS_ENABLED(CONFIG_WIFI_TP_TCP_SERVER_OT_TP_SERVER)) {
		ret = wifi_tput_ot_tput(test_wifi, is_ant_mode_sep,
		test_thread, is_ot_client, is_wifi_server, is_wifi_zperf_udp);
	}

	if (IS_ENABLED(CONFIG_WIFI_CON_STABILITY_OT_DISC_INTERFERENCE)) {
		ret = wifi_con_stability_ot_discov_interference(test_wifi, test_thread, is_ot_client,
		is_ant_mode_sep);
	}

	if (IS_ENABLED(CONFIG_WIFI_CON_STABILITY_OT_TP_CLIENT_INTERFERENCE) ||
	IS_ENABLED(CONFIG_WIFI_CON_STABILITY_OT_TP_SERVER_INTERFERENCE)) {
		ret = wifi_con_stability_ot_tput_interference(test_wifi, is_ant_mode_sep, test_thread,
			is_ot_client);
	}

	if (IS_ENABLED(CONFIG_OT_CON_STABILITY_WIFI_SCAN_INTERFERENCE) ||
	IS_ENABLED(CONFIG_OT_CON_STABILITY_WIFI_CON_SCAN_INTERFERENCE)) {
		ret = ot_con_stability_wifi_scan_interference(is_ant_mode_sep, test_thread, test_wifi,
		is_ot_client, is_wifi_conn_scan);
	}

	if (IS_ENABLED(CONFIG_OT_CON_STABILITY_WIFI_TP_UDP_CLIENT_INTERFERENCE) ||
	IS_ENABLED(CONFIG_OT_CON_STABILITY_WIFI_TP_TCP_CLIENT_INTERFERENCE) ||
	IS_ENABLED(CONFIG_OT_CON_STABILITY_WIFI_TP_UDP_SERVER_INTERFERENCE) ||
	IS_ENABLED(CONFIG_OT_CON_STABILITY_WIFI_TP_TCP_SERVER_INTERFERENCE)) {
		ret = ot_connection_stability_wifi_tput_interference(test_wifi, test_thread,
		is_ot_client, is_wifi_server, is_ant_mode_sep, is_wifi_zperf_udp);
	}

	if (IS_ENABLED(CONFIG_WIFI_SHUTDOWN_OT_DISCOV)) {
		ret = wifi_shutdown_ot_discov(is_ot_client);
	}
	
	if (IS_ENABLED(CONFIG_WIFI_SHUTDOWN_OT_CONNECTION)) {
		ret = wifi_shutdown_ot_connection(is_ot_client);
	}
	
	if (IS_ENABLED(CONFIG_WIFI_SHUTDOWN_OT_TP_CLIENT) ||
	IS_ENABLED(CONFIG_WIFI_SHUTDOWN_OT_TP_SERVER)) {
		ret = wifi_shutdown_ot_tput(is_ot_client);
	}
	
	if (ret != 0) {
		LOG_INF("Test case failed");
		goto err;
	}
	if (ot_tx_power != TXPOWER_INIT_VALUE) {
		LOG_INF("Thread Tx power: %d", ot_tx_power);
	} else {
		LOG_INF("Thread Tx power: N/A");
	}
	if (wifi_rssi != RSSI_INIT_VALUE) {
		LOG_INF("Wi-Fi RSSI: %d", wifi_rssi);
	} else {
		LOG_INF("Wi-Fi RSSI: N/A");
	}
	if (ot_rssi != RSSI_INIT_VALUE) {
		LOG_INF("Thread RSSI: %d", ot_rssi);
	} else {
		LOG_INF("Thread RSSI: N/A");
	}
	LOG_INF("Test case(s) complete");

	return 0;

err:
	LOG_INF("Returning with error");
	return ret;
}
```

## src/bt_coex_test_functions.h
```c
/*
 * Copyright (c) 2023 Nordic Semiconductor ASA
 *
 * SPDX-License-Identifier: LicenseRef-Nordic-5-Clause
 */

#ifndef BT_COEX_TEST_FUNCTIONS_
#define BT_COEX_TEST_FUNCTIONS_

#include <stdio.h>
#include <stdlib.h>
#include <string.h>

#include <bluetooth/scan.h>

#include <zephyr/logging/log.h>
LOG_MODULE_REGISTER(bt_coex_test_func, CONFIG_LOG_DEFAULT_LEVEL);

#include <nrfx_clock.h>
#include <zephyr/kernel.h>
#include <zephyr/init.h>
#include <zephyr/device.h>
#include <zephyr/devicetree.h>
#include <zephyr/drivers/gpio.h>

#include <zephyr/shell/shell.h>
#include <zephyr/shell/shell_uart.h>

#include <zephyr/sys/byteorder.h>
#include <zephyr/net/zperf.h>
#include <zephyr/net/net_if.h>
#include <zephyr/net/wifi_mgmt.h>
#include <zephyr/net/net_event.h>
#include <zephyr/net/socket.h>

/* For net_sprint_ll_addr_buf */
#include "net_private.h"
#include <zephyr_coex.h>
#include <zephyr_coex_struct.h>
#include "bt_utils.h"
#include "zephyr_fmac_main.h"
#define MAX_SSID_LEN 32
#define WIFI_CONNECTION_TIMEOUT 30 /* in seconds */
#define WIFI_DHCP_TIMEOUT 10 /* in seconds */

#define DEMARCATE_TEST_START

#define RSSI_INIT_VALUE 127

#define HIGHEST_CHANNUM_24G 14

#define KSLEEP_WIFI_CON_2SEC K_SECONDS(2)
#define KSLEEP_WIFI_DISCON_2SEC K_SECONDS(2)
//#define KSLEEP_WIFI_CON_10MSEC K_MSEC(10)
#define KSLEEP_WIFI_CON_10MSEC K_SECONDS(1)
//#define KSLEEP_WIFI_DISCON_10MSEC K_MSEC(10)
#define KSLEEP_WIFI_DISCON_10MSEC K_SECONDS(1)
#define KSLEEP_WHILE_ONLY_TEST_DUR_CHECK_1SEC K_SECONDS(1)
#define KSLEEP_WHILE_PERIP_CONN_CHECK_1SEC K_SECONDS(1)
#define KSLEEP_ADV_START_1SEC K_SECONDS(1)
#define KSLEEP_SCAN_START_1SEC K_SECONDS(1)
#define KSLEEP_WHILE_DISCON_CENTRAL_2SEC K_SECONDS(2)


static uint32_t wifi_scan_cnt_24g;
static uint32_t wifi_scan_cnt_5g;
extern uint32_t wifi_scan_cmd_cnt;

static uint32_t wifi_conn_attempt_cnt;
static uint32_t wifi_conn_success_cnt;
static uint32_t wifi_conn_fail_cnt;
static uint32_t wifi_conn_timeout_cnt;
static uint32_t wifi_dhcp_timeout_cnt;

static uint32_t wifi_disconn_attempt_cnt;
static uint32_t wifi_disconn_success_cnt;
static uint32_t wifi_disconn_fail_cnt;
static uint32_t wifi_disconn_no_conn_cnt;

static uint32_t wifi_conn_cnt_stability;
static uint32_t wifi_disconn_cnt_stability;

static uint8_t wait4_peer_wifi_client_to_start_tp_test;

extern bool ble_periph_connected;
extern bool ble_central_connected;
uint8_t wait4_peer_ble2_start_connection;
uint32_t run_ble_central_wait_in_conn;

extern uint32_t ble_supervision_timeout;

extern uint32_t ot_discov_attempt_cnt;
extern uint32_t ot_discov_success_cnt;
extern uint32_t ot_discov_no_result_cnt;

extern uint32_t ble_disconnection_attempt_cnt;
extern uint32_t ble_disconnection_success_cnt;
extern uint32_t ble_disconnection_fail_cnt;
extern uint32_t ble_discon_no_conn_cnt;
extern uint32_t ble_discon_no_conn;

extern uint32_t ble_disconn_cnt_stability;

static struct net_mgmt_event_callback wifi_sta_mgmt_cb;
static struct net_mgmt_event_callback net_addr_mgmt_cb;

static struct sockaddr_in in4_addr_my = {
	.sin_family = AF_INET,
	.sin_port = htons(CONFIG_NET_CONFIG_PEER_IPV4_PORT),
};

#define WIFI_MGMT_EVENTS (NET_EVENT_WIFI_CONNECT_RESULT | NET_EVENT_WIFI_DISCONNECT_RESULT)

/**
 * @brief Handle net management events
 *
 * @return No return value.
 */
void net_mgmt_event_handler(struct net_mgmt_event_callback *cb, uint32_t mgmt_event,
		struct net_if *iface);

/**
 * @brief Handle Wi-Fi management events
 *
 * @return No return value.
 */
void wifi_mgmt_event_handler(struct net_mgmt_event_callback *cb, uint32_t mgmt_event,
		struct net_if *iface);

static uint32_t scan_result_count;

/**
 * @brief Disable RPU.
 *
 * @return None
 */
void rpu_disable(void);

/**
 * @brief BT throughtput test run
 *
 * @return None
 */
void run_bt_benchmark(void);

/**
 * @brief BT connection test run
 *
 * @return None
 */
void run_bt_connection_test(void);

/**
 * @brief Wi-Fi scan test run
 *
 * @return None
 */
void run_wifi_scan_test(void);

/**
 * @brief Wi-Fi connection test run
 *
 * @return None
 */
void run_wifi_conn_test(void);

/**
 * @brief commnad to start Wi-Fi scan
 *
 * @return Zero on success or (negative) error code otherwise.
 */
int cmd_wifi_scan(void);
/**
 * @brief Call Wi-Fi connection event
 *
 * @return Zero on success or (negative) error code otherwise.
 */
int wifi_connection(void);
/**
 * @brief configure PTA registers
 *
 * @return Zero on success or (negative) error code otherwise.
 */
int config_pta(bool is_ant_mode_sep, bool is_ble_central,
				bool is_wlan_server);
/**
 * @brief Start wi-fi traffic for zperf udp upload or configure
 * zperf traffic for udp download
 *
 * @return Zero on success or (negative) error code otherwise.
 */
int run_wifi_traffic_udp(void);

/**
 * @brief Start wi-fi traffic for zperf tcp upload or configure
 * zperf traffic for tcp download
 *
 * @return Zero on success or (negative) error code otherwise.
 */
int run_wifi_traffic_tcp(void);

/**
 * @brief start BLE connection/traffic using thread start
 *
 * @return None
 */
void start_ble_activity(void);

/**
 * @brief start Wi-Fi scan using thread start
 *
 * @return None
 */
void start_wifi_activity(void);

/**
 * @brief check if iperf traffic is complete
 *
 * @return None
 */
void check_wifi_traffic(void);
/**
 * @brief Run BLE traffic using thread join
 *
 * @return None
 */
void run_ble_activity(void);
/**
 * @brief Disconnect Wi-Fi
 *
 * @return None
 */
void wifi_disconnection(void);
/**
 * @brief Exit BLE throughput test
 *
 * @return None
 */
void exit_bt_throughput_test(void);

static struct {
	uint8_t connected :1;
	uint8_t disconnect_requested: 1;
	uint8_t _unused : 6;
} context;

K_SEM_DEFINE(wait_for_next, 0, 1);
K_SEM_DEFINE(udp_tcp_callback, 0, 1);

struct wifi_iface_status status = { 0 };
uint32_t repeat_wifi_scan = 1;


#if defined(CONFIG_WIFI_SCAN_BLE_TP_CENTRAL) || \
	defined(CONFIG_WIFI_SCAN_BLE_TP_PERIPH) || \
	defined(CONFIG_WIFI_CON_SCAN_BLE_TP_CENTRAL) || \
	defined(CONFIG_WIFI_CON_SCAN_BLE_TP_PERIPH) || \
	defined(CONFIG_WIFI_CON_BLE_TP_CENTRAL) || \
	defined(CONFIG_WIFI_CON_BLE_TP_PERIPH) || \
	defined(CONFIG_WIFI_TP_UDP_CLIENT_BLE_TP_CENTRAL) || \
	defined(CONFIG_WIFI_TP_UDP_CLIENT_BLE_TP_PERIPH) || \
	defined(CONFIG_WIFI_TP_UDP_SERVER_BLE_TP_CENTRAL) || \
	defined(CONFIG_WIFI_TP_UDP_SERVER_BLE_TP_PERIPH) || \
	defined(CONFIG_WIFI_TP_TCP_CLIENT_BLE_TP_CENTRAL) || \
	defined(CONFIG_WIFI_TP_TCP_CLIENT_BLE_TP_PERIPH) || \
	defined(CONFIG_WIFI_TP_TCP_SERVER_BLE_TP_CENTRAL) || \
	defined(CONFIG_WIFI_TP_TCP_SERVER_BLE_TP_PERIPH) || \
	defined(CONFIG_WIFI_CON_BLE_TP_CENTRAL_STABILITY) || \
	defined(CONFIG_WIFI_CON_BLE_TP_PERIPH_STABILITY) || \
	defined(CONFIG_BLE_TP_CENTRAL_WIFI_SHUTDOWN) || \
	defined(CONFIG_BLE_TP_PERIPH_WIFI_SHUTDOWN)

	#define ENABLE_BLE_TRAFFIC_TEST

	K_THREAD_DEFINE(run_bt_traffic,
		CONFIG_WIFI_THREAD_STACK_SIZE,
		run_bt_benchmark,
		NULL,
		NULL,
		NULL,
		CONFIG_WIFI_THREAD_PRIORITY,
		0,
		K_TICKS_FOREVER);
#endif

#if defined(CONFIG_WIFI_SCAN_BLE_CON_CENTRAL) || \
	defined(CONFIG_WIFI_CON_SCAN_BLE_CON_CENTRAL) || \
	defined(CONFIG_WIFI_SCAN_BLE_CON_PERIPH) || \
	defined(CONFIG_WIFI_CON_SCAN_BLE_CON_PERIPH) || \
	defined(CONFIG_WIFI_TP_UDP_CLIENT_BLE_CON_CENTRAL) || \
	defined(CONFIG_WIFI_TP_UDP_CLIENT_BLE_CON_PERIPH) || \
	defined(CONFIG_WIFI_TP_UDP_SERVER_BLE_CON_CENTRAL) || \
	defined(CONFIG_WIFI_TP_UDP_SERVER_BLE_CON_PERIPH) || \
	defined(CONFIG_WIFI_TP_TCP_CLIENT_BLE_CON_CENTRAL) || \
	defined(CONFIG_WIFI_TP_TCP_CLIENT_BLE_CON_PERIPH) || \
	defined(CONFIG_WIFI_TP_TCP_SERVER_BLE_CON_CENTRAL) || \
	defined(CONFIG_WIFI_TP_TCP_SERVER_BLE_CON_PERIPH) || \
	defined(CONFIG_BLE_CONN_CENTRAL_WIFI_SCAN_STABILITY) || \
	defined(CONFIG_BLE_CONN_CENTRAL_WIFI_CON_SCAN_STABILITY) || \
	defined(CONFIG_BLE_CONN_CENTRAL_WIFI_CON_STABILITY) || \
	defined(CONFIG_BLE_CONN_CENTRAL_WIFI_TP_UDP_CLIENT_STABILITY) || \
	defined(CONFIG_BLE_CONN_CENTRAL_WIFI_TP_UDP_SERVER_STABILITY) || \
	defined(CONFIG_BLE_CONN_CENTRAL_WIFI_TP_TCP_CLIENT_STABILITY) || \
	defined(CONFIG_BLE_CONN_CENTRAL_WIFI_TP_TCP_SERVER_STABILITY) || \
	defined(CONFIG_BLE_CONN_PERIPHERAL_WIFI_SCAN_STABILITY) || \
	defined(CONFIG_BLE_CONN_PERIPHERAL_WIFI_CON_SCAN_STABILITY) || \
	defined(CONFIG_BLE_CONN_PERIPHERAL_WIFI_CON_STABILITY) || \
	defined(CONFIG_BLE_CONN_PERIPHERAL_WIFI_TP_UDP_CLIENT_STABILITY) || \
	defined(CONFIG_BLE_CONN_PERIPHERAL_WIFI_TP_UDP_SERVER_STABILITY) || \
	defined(CONFIG_BLE_CONN_PERIPHERAL_WIFI_TP_TCP_CLIENT_STABILITY) || \
	defined(CONFIG_BLE_CONN_PERIPHERAL_WIFI_TP_TCP_SERVER_STABILITY) || \
	defined(CONFIG_BLE_CON_CENTRAL_WIFI_SHUTDOWN) || \
	defined(CONFIG_BLE_CON_PERIPHERAL_WIFI_SHUTDOWN)

	#define ENABLE_BLE_CONN_TEST

	K_THREAD_DEFINE(run_bt_connection,
		CONFIG_WIFI_THREAD_STACK_SIZE,
		run_bt_connection_test,
		NULL,
		NULL,
		NULL,
		CONFIG_WIFI_THREAD_PRIORITY,
		0,
		K_TICKS_FOREVER);
#endif

#if defined(CONFIG_WIFI_SCAN_BLE_CON_CENTRAL) || \
	defined(CONFIG_WIFI_SCAN_BLE_CON_PERIPH) || \
	defined(CONFIG_WIFI_SCAN_BLE_TP_CENTRAL) || \
	defined(CONFIG_WIFI_SCAN_BLE_TP_PERIPH) || \
	defined(CONFIG_WIFI_CON_SCAN_BLE_CON_CENTRAL) || \
	defined(CONFIG_WIFI_CON_SCAN_BLE_CON_PERIPH) || \
	defined(CONFIG_WIFI_CON_SCAN_BLE_TP_CENTRAL) || \
	defined(CONFIG_WIFI_CON_SCAN_BLE_TP_PERIPH)	|| \
	defined(CONFIG_BLE_CONN_CENTRAL_WIFI_SCAN_STABILITY) || \
	defined(CONFIG_BLE_CONN_CENTRAL_WIFI_CON_SCAN_STABILITY) || \
	defined(CONFIG_BLE_CONN_PERIPHERAL_WIFI_SCAN_STABILITY) || \
	defined(CONFIG_BLE_CONN_PERIPHERAL_WIFI_CON_SCAN_STABILITY)

	#define ENABLE_WIFI_SCAN_TEST

	K_THREAD_DEFINE(run_wlan_scan,
		CONFIG_WIFI_THREAD_STACK_SIZE,
		run_wifi_scan_test,
		NULL,
		NULL,
		NULL,
		CONFIG_WIFI_THREAD_PRIORITY,
		0,
		K_TICKS_FOREVER);
#endif

#if defined(CONFIG_WIFI_CON_BLE_TP_CENTRAL) || defined(CONFIG_WIFI_CON_BLE_TP_PERIPH)

	#define ENABLE_WIFI_CONN_TEST

	K_THREAD_DEFINE(run_wlan_conn,
		CONFIG_WIFI_THREAD_STACK_SIZE,
		run_wifi_conn_test,
		NULL,
		NULL,
		NULL,
		CONFIG_WIFI_THREAD_PRIORITY,
		0,
		K_TICKS_FOREVER);
#endif

/**
 * @brief Print Wi-Fi status
 *
 * @return Zero on success or (negative) error code otherwise.
 */
int cmd_wifi_status(void);
/**
 * @brief Initailise Wi-Fi arguments in variables
 *
 * @return Zero on success or (negative) error code otherwise.
 */
int __wifi_args_to_params(struct wifi_connect_req_params *params);
/**
 * @brief Request Wi-Fi connection
 *
 * @return Zero on success or (negative) error code otherwise.
 */
int wifi_connect(void);
/**
 * @brief Request Wi-Fi disconnection
 *
 * @return Zero on success or (negative) error code otherwise.
 */
int wifi_disconnect(void);
/**
 * @brief parse Wi-Fi IPv4 address
 *
 * @return Zero on success or (negative) error code otherwise.
 */
int parse_ipv4_addr(char *host, struct sockaddr_in *addr);
/**
 * @brief wait for next Wi-Fi event
 *
 * @return Zero on success or (negative) error code otherwise.
 */
int wait_for_next_event(const char *event_name, int timeout);
/**
 * @brief Callback for UDP download results
 *
 * @return Zero on success or (negative) error code otherwise.
 */
void udp_download_results_cb(enum zperf_status status,
							struct zperf_results *result,
							void *user_data);
/**
 * @brief Callback for UDP upload results
 *
 * @return Zero on success or (negative) error code otherwise.
 */
void udp_upload_results_cb(enum zperf_status status,
							struct zperf_results *result,
							void *user_data);
/**
 * @brief Callback for TCP download results
 *
 * @return Zero on success or (negative) error code otherwise.
 */
void tcp_download_results_cb(enum zperf_status status,
							struct zperf_results *result,
							void *user_data);
/**
 * @brief Callback for TCP upload results
 *
 * @return Zero on success or (negative) error code otherwise.
 */
void tcp_upload_results_cb(enum zperf_status status,
							struct zperf_results *result,
							void *user_data);
/**
 * @brief Run Wi-Fi scan test
 */
void wifi_scan_test_run(void);

/**
 * @brief Run Wi-Fi connection test
 */
void wifi_connection_test_run(void);

/**
 * @brief Start BLE advertisement
 *
 * @return None
 */
void adv_start(void);

/**
 * @brief Start BLE scan
 *
 * @return None
 */
void scan_start(void);

/**
 * @brief Callback for Wi-Fi DHCP IP address
 *
 * @return None
 */
void print_dhcp_ip(struct net_mgmt_event_callback *cb);
/**
 * @brief Callback for Wi-Fi connection result
 *
 * @return No return value.
 */
void handle_wifi_connect_result(struct net_mgmt_event_callback *cb);

/**
 * @brief Callback for Wi-Fi disconnection result
 *
 * @return No return value.
 */
void handle_wifi_disconnect_result(struct net_mgmt_event_callback *cb);
/**
 * @brief Callback for Wi-Fi scan result
 *
 * @return No return value.
 */
void handle_wifi_scan_result(struct net_mgmt_event_callback *cb);

/**
 * @brief Callback for Wi-Fi scan done
 *
 * @return No return value.
 */
void handle_wifi_scan_done(struct net_mgmt_event_callback *cb);

/**
 * @brief Callback for Wi-Fi DHCP IP addreds assigned
 *
 * @return No return value.
 */
void print_dhcp_ip(struct net_mgmt_event_callback *cb);
/**
 * @brief Print common test parameters info
 *
 * @return None
 */
void print_common_test_params(bool is_ant_mode_sep, bool test_ble, bool test_wlan,
	bool is_ble_central);
/**
 * @brief Print BLE connection test parameters info
 *
 * @return None
 */
void print_ble_connection_test_params(bool is_ble_central);

#ifdef CONFIG_TWT_ENABLE
	/**
	 * @brief Tear down TWT
	 *
	 * @return success/fail
	 */
	static int teardown_twt(void);

	/**
	 * @brief Wait for TWT response
	 *
	 * @return success/fail
	 */
	static int wait_for_twt_resp_received(void);

	/**
	 * @brief Setup TWT
	 *
	 * @return success/fail
	 */
	static int setup_twt(void);

	/**
	 * @brief Print TWT parameters
	 *
	 * @return None
	 */
	void print_twt_params(uint8_t dialog_token, uint8_t flow_id,
				     enum wifi_twt_negotiation_type negotiation_type,
				     bool responder, bool implicit, bool announce,
				     bool trigger, uint32_t twt_wake_interval,
				     uint64_t twt_interval);
#endif

#endif /* BT_COEX_TEST_FUNCTIONS_ */
```

## src/bt_utils.h
```c
/*
 * Copyright (c) 2023 Nordic Semiconductor ASA
 *
 * SPDX-License-Identifier: LicenseRef-Nordic-5-Clause
 */

#ifndef BT_UTILS_H_
#define BT_UTILS_H_

#include <stdint.h>
#include <stdbool.h>

#define RSSI_INIT_VALUE 127

/**
 * Initialize BLE throughput test
 *
 * @return Zero on success or (negative) error code otherwise.
 */
int bt_throughput_test_init(bool is_ble_central);

/**
 * @brief Run BLE throughput test
 *
 * @return Zero on success or (negative) error code otherwise.
 */
int bt_throughput_test_run(void);

/**
 * @brief Run BLE connection test
 */
void bt_conn_test_run(void);

/**
 * @brief Exit BLE throughput test
 *
 * @return Zero on success or (negative) error code otherwise.
 */
int bt_throughput_test_exit(void);
/**
 * Initialize BLE scan --> connection test
 *
 * @return Zero on success or (negative) error code otherwise.
 */
int bt_connection_init(bool is_ble_central);

/**
 * @brief Initialization for BT connection
 *
 * @return Zero on success or (negative) error code otherwise.
 */
int bt_disconnect_central(void);

/**
 * @brief Start BLE advertisement
 *
 * @return None
 */
void adv_start(void);

/**
 * @brief Start BLE scan
 *
 * @return None
 */
void scan_start(void);

/**
 * @brief Read BLE RSSI
 *
 * @return None
 */
void read_conn_rssi(uint16_t handle, int8_t *rssi);

/**
 * @brief Set BLE Tx power
 *
 * @return None
 */
void set_tx_power(uint8_t handle_type, uint16_t handle, int8_t tx_pwr_lvl);

/**
 * @brief Get BLE Tx power
 *
 * @return None
 */
void get_tx_power(uint8_t handle_type, uint16_t handle, int8_t *tx_pwr_lvl);

/**
 * @brief Start OpenThread discovery
 *
 * @return None
 */
void open_thread_discover_start(void);


#endif /* BT_UTILS_H_ */
```

## src/main.h
```c
/*
 * Copyright (c) 2023 Nordic Semiconductor ASA
 *
 * SPDX-License-Identifier: LicenseRef-Nordic-5-Clause
 */

#ifndef MAIN_H_
#define MAIN_H_

#include <stdio.h>
#include <stdlib.h>
#include <string.h>
#include <stdbool.h>

#include <zephyr/logging/log.h>
LOG_MODULE_REGISTER(main, CONFIG_LOG_DEFAULT_LEVEL);

#include <nrfx_clock.h>

#include <zephyr/kernel.h>
#include <zephyr/init.h>
#include <zephyr/device.h>
#include <zephyr/devicetree.h>
#include <zephyr/drivers/gpio.h>
#include <zephyr/shell/shell.h>
#include <zephyr/shell/shell_uart.h>
#include <zephyr/sys/byteorder.h>
#include <zephyr/net/zperf.h>
#include <zephyr/net/net_if.h>
#include <zephyr/net/wifi_mgmt.h>
#include <zephyr/net/net_event.h>
#include <zephyr/net/socket.h>

#include "coex.h"
#include "fmac_main.h"

#define RSSI_INIT_VALUE 127
#define TXPOWER_INIT_VALUE 127

extern int8_t wifi_rssi;
extern int8_t ot_tx_power;
extern int8_t ot_rssi;

/**
 * @brief Function to test Wi-Fi scan/connected-scan and Thread discovery
 *
 * @return Zero on success or (negative) error code otherwise.
 */
int wifi_scan_ot_discov(bool is_ant_mode_sep, bool test_thread, bool test_wifi,
		bool is_ot_client, bool is_wifi_conn_scan);

/**
 * @brief Function to test Wi-Fi scan/connected-scan and Thread connection
 *
 * @return Zero on success or (negative) error code otherwise.
 */
int wifi_scan_ot_connection(bool is_ant_mode_sep, bool test_thread, bool test_wifi,
		bool is_ot_client, bool is_wifi_conn_scan);

/**
 * @brief Function to test Wi-Fi scan/connected-scan and Thread throughput client/server
 *
 * @return Zero on success or (negative) error code otherwise.
 */
int wifi_scan_ot_tput(bool is_ant_mode_sep, bool test_thread, bool test_wifi,
		bool is_ot_client, bool is_wifi_conn_scan);

/**
 * @brief Function to test Wi-Fi connection and Thread discovery
 *
 * @return Zero on success or (negative) error code otherwise.
 */
int wifi_con_ot_discov(bool test_wifi, bool is_ant_mode_sep,	bool test_thread, bool is_ot_client);

/**
 * @brief Function to test Wi-Fi connection and Thread throughput client/server
 *
 * @return Zero on success or (negative) error code otherwise.
 */
int wifi_con_ot_tput(bool test_wifi, bool is_ant_mode_sep,	bool test_thread, bool is_ot_client);

/**
 * @brief Function to test Wi-Fi throughput client/server and Thread discovery
 *
 * @return Zero on success or (negative) error code otherwise.
 */
int wifi_tput_ot_discov(bool test_wifi, bool test_thread, bool is_ot_client,
		bool is_wifi_server, bool is_ant_mode_sep, bool is_wifi_zperf_udp);

/**
 * @brief Function to test Wi-Fi throughput client/server and Thread connection
 *
 * @return Zero on success or (negative) error code otherwise.
 */
int wifi_tput_ot_connection(bool test_wifi, bool test_thread, bool is_ot_client,
		bool is_wifi_server, bool is_ant_mode_sep, bool is_wifi_zperf_udp);


/**
 * @brief Function to test Wi-Fi throughput client/server and Thread throughput client/server
 *
 * @return Zero on success or (negative) error code otherwise.
 */
int wifi_tput_ot_tput(bool test_wifi, bool is_ant_mode_sep, bool test_thread,
		bool is_ot_client, bool is_wifi_server, bool is_wifi_zperf_udp);

/**
 * @brief Function to test Wi-Fi connection stability with Thread discovery as interference
 *
 * @return Zero on success or (negative) error code otherwise.
 */
int wifi_con_stability_ot_discov_interference(bool test_wifi, bool test_thread, bool is_ot_client,
		bool is_ant_mode_sep);

/**
 * @brief Function to test Wi-Fi connection stability with Thread throughput client/server
 * as interference
 *
 * @return Zero on success or (negative) error code otherwise.
 */
int wifi_con_stability_ot_tput_interference(bool test_wifi, bool is_ant_mode_sep, bool test_thread,
	bool is_ot_client);

/**
 * @brief Function to test Thread connection stability with Wi-Fi scan/
 * connected-scan as interference
 *
 * @return Zero on success or (negative) error code otherwise.
 */
int ot_con_stability_wifi_scan_interference(bool is_ant_mode_sep, bool test_thread, bool test_wifi,
		bool is_ot_client, bool is_wifi_conn_scan);

/**
 * @brief Function to test Thread connection stability with Wi-Fi throughput
 * (client/server) as interference
 *
 * @return Zero on success or (negative) error code otherwise.
 */
int ot_connection_stability_wifi_tput_interference(bool test_wifi, bool test_thread, bool is_ot_client,
	bool is_wifi_server, bool is_ant_mode_sep, bool is_wifi_zperf_udp);

/**
 * @brief Function to test Thread discovery functionality with Wi-Fi shutdown
 *
 * @return Zero on success or (negative) error code otherwise.
 */
int wifi_shutdown_ot_discov(bool is_ot_client);

/**
 * @brief Function to test Thread connection functionality with Wi-Fi shutdown
 *
 * @return Zero on success or (negative) error code otherwise.
 */
int wifi_shutdown_ot_connection(bool is_ot_client);

/**
 * @brief Function to test Thread throughput client/server functionality with Wi-Fi shutdown
 *
 * @return Zero on success or (negative) error code otherwise.
 */
int wifi_shutdown_ot_tput(bool is_ot_client);

/**
 * @brief memset_context
 *
 * @return No return value.
 */
void memset_context(void);
/**
 * @brief Handle net management callbacks
 *
 * @return No return value.
 */
void wifi_net_mgmt_callback_functions(void);

/**
 * @brief Wi-Fi init.
 *
 * @return None
 */
void wifi_init(void);

#endif /* MAIN_H_ */
```

## src/ot_coex_functions.h
```c
/*
 * Copyright (c) 2023 Nordic Semiconductor ASA
 *
 * SPDX-License-Identifier: LicenseRef-Nordic-5-Clause
 */

#ifndef OT_COEX_FUNCTIONS_
#define OT_COEX_FUNCTIONS_

#include <stdio.h>
#include <stdlib.h>
#include <string.h>

#include <zephyr/logging/log.h>
LOG_MODULE_REGISTER(ot_coex_functions, CONFIG_LOG_DEFAULT_LEVEL);

#include <nrfx_clock.h>

#include <zephyr/kernel.h>
#include <zephyr/init.h>
#include <zephyr/device.h>
#include <zephyr/devicetree.h>
#include <zephyr/drivers/gpio.h>
#include <zephyr/shell/shell.h>
#include <zephyr/shell/shell_uart.h>
#include <zephyr/sys/byteorder.h>
#include <zephyr/net/zperf.h>
#include <zephyr/net/net_if.h>
#include <zephyr/net/wifi_mgmt.h>
#include <zephyr/net/net_event.h>
#include <zephyr/net/socket.h>

/* For net_sprint_ll_addr_buf */
#include "net_private.h"
#include "coex.h"
#include "coex_struct.h"
#include "ot_utils.h" 
#include "fmac_main.h"

#define MAX_SSID_LEN 32
#define WIFI_CONNECTION_TIMEOUT 30 /* in seconds */
#define WIFI_DHCP_TIMEOUT 10 /* in seconds */

#define DEMARCATE_TEST_START

#define TXPOWER_INIT_VALUE 127
#define RSSI_INIT_VALUE 127

#define HIGHEST_CHANNUM_24G 14


#define KSLEEP_WIFI_DISCON_2SEC K_SECONDS(2)
#define KSLEEP_WIFI_CON_10MSEC K_SECONDS(1)
#define KSLEEP_WIFI_DISCON_10MSEC K_SECONDS(1)
#define KSLEEP_WHILE_ONLY_TEST_DUR_CHECK_1SEC K_SECONDS(1)
#define KSLEEP_WHILE_PERIP_CONN_CHECK_1SEC K_SECONDS(1)


static uint32_t wifi_scan_cnt_24g;
static uint32_t wifi_scan_cnt_5g;
extern uint32_t wifi_scan_cmd_cnt;
uint64_t wifi_scan_start_time;
uint64_t wifi_scan_time;
uint32_t print_wifi_scan_time;

static uint32_t wifi_conn_attempt_cnt;
static uint32_t wifi_conn_success_cnt;
static uint32_t wifi_conn_fail_cnt;
static uint32_t wifi_conn_timeout_cnt;
static uint32_t wifi_conn_cnt_stability;
static uint32_t wifi_dhcp_timeout_cnt;

extern uint32_t wifi_disconn_no_conn_cnt;
extern uint32_t wifi_disconn_fail_cnt;
extern uint32_t wifi_disconn_success_cnt;
static uint32_t wifi_disconn_attempt_cnt;
static uint32_t wifi_disconn_cnt_stability;

static uint8_t wait4_peer_wifi_client_to_start_tp_test;

extern uint32_t ot_discov_attempt_cnt;
extern uint32_t ot_discov_success_cnt;
extern uint32_t ot_discov_no_result_cnt;
extern uint32_t repeat_ot_discovery;
uint32_t ot_discov_timeout;
uint32_t ot_discov_attempts_before_test_starts;

extern uint32_t ot_connection_attempt_cnt;
extern uint32_t ot_connection_success_cnt;
uint8_t wait4_peer_ot2_start_connection;
uint32_t ot_conn_attempts_before_test_starts;
uint32_t run_ot_client_wait_in_conn;
extern bool ot_server_connected;
extern bool ot_client_connected;
extern uint32_t ot_disconnection_attempt_cnt;
extern uint32_t ot_disconnection_success_cnt;
extern uint32_t ot_disconnection_fail_cnt;
extern uint32_t ot_discon_no_conn_cnt;
extern uint32_t ot_discon_no_conn;
extern uint32_t ot_disconn_cnt_stability;

static struct sockaddr_in in4_addr_my = {
	.sin_family = AF_INET,
	.sin_port = htons(CONFIG_NET_CONFIG_PEER_IPV4_PORT),
};



///**
// * @brief Handle Wi-Fi management events
// *
// * @return No return value.
// */
//void wifi_mgmt_event_handler(struct net_mgmt_event_callback *cb, uint32_t mgmt_event,
//		struct net_if *iface);

static uint32_t scan_result_count;

/**
 * @brief Disable RPU.
 *
 * @return None
 */
void rpu_disable(void);

/**
 * @brief BT throughtput test run
 *
 * @return None
 */
void run_ot_benchmark(void);

/**
 * @brief Thread discovery test run
 *
 * @return None
 */
void run_ot_discovery_test(void);

/**
 * @brief BT connection test run
 *
 * @return None
 */
void run_ot_connection_test(void);

/**
 * @brief Wi-Fi scan test run
 *
 * @return None
 */
void run_wifi_scan_test(void);

/**
 * @brief Wi-Fi connection test run
 *
 * @return None
 */
void run_wifi_conn_test(void);

/**
 * @brief commnad to start Wi-Fi scan
 *
 * @return Zero on success or (negative) error code otherwise.
 */
int cmd_wifi_scan(void);
/**
 * @brief Call Wi-Fi connection event
 *
 * @return Zero on success or (negative) error code otherwise.
 */
int wifi_connection(void);
/**
 * @brief configure PTA registers
 *
 * @return Zero on success or (negative) error code otherwise.
 */
int config_pta(bool is_ant_mode_sep, bool is_ot_client,
				bool is_wifi_server);
/**
 * @brief Start wi-fi traffic for zperf udp upload or configure
 * zperf traffic for udp download
 *
 * @return Zero on success or (negative) error code otherwise.
 */
int run_wifi_traffic_udp(void);

/**
 * @brief Start wi-fi traffic for zperf tcp upload or configure
 * zperf traffic for tcp download
 *
 * @return Zero on success or (negative) error code otherwise.
 */
int run_wifi_traffic_tcp(void);

/**
 * @brief start Thread connection/traffic using thread start
 *
 * @return None
 */
void start_ot_activity(void);

/**
 * @brief start Wi-Fi scan using thread start
 *
 * @return None
 */
void start_wifi_activity(void);

/**
 * @brief check if iperf traffic is complete
 *
 * @return None
 */
void check_wifi_traffic(void);
/**
 * @brief Run Thread traffic using thread join
 *
 * @return None
 */
void run_ot_activity(void);
/**
 * @brief Disconnect Wi-Fi
 *
 * @return None
 */
void wifi_disconnection(void);
/**
 * @brief Exit Thread throughput test
 *
 * @return None
 */
void ot_throughput_test_exit(void);

static struct {
	uint8_t connected :1;
	uint8_t disconnect_requested: 1;
	uint8_t _unused : 6;
} context;

K_SEM_DEFINE(wait_for_next, 0, 1);
K_SEM_DEFINE(udp_tcp_callback, 0, 1);

struct wifi_iface_status status = { 0 };
uint32_t repeat_wifi_scan = 1;

#if defined(CONFIG_WIFI_SCAN_OT_TP_CLIENT) || \
	defined(CONFIG_WIFI_SCAN_OT_TP_SERVER) || \
	defined(CONFIG_WIFI_CON_SCAN_OT_TP_CLIENT) || \
	defined(CONFIG_WIFI_CON_SCAN_OT_TP_SERVER) || \
	defined(CONFIG_WIFI_CON_OT_TP_CLIENT) || \
	defined(CONFIG_WIFI_CON_OT_TP_SERVER) || \
	defined(CONFIG_WIFI_TP_UDP_CLIENT_OT_TP_CLIENT) || \
	defined(CONFIG_WIFI_TP_UDP_CLIENT_OT_TP_SERVER) || \
	defined(CONFIG_WIFI_TP_UDP_SERVER_OT_TP_CLIENT) || \
	defined(CONFIG_WIFI_TP_UDP_SERVER_OT_TP_SERVER) || \
	defined(CONFIG_WIFI_TP_TCP_CLIENT_OT_TP_CLIENT) || \
	defined(CONFIG_WIFI_TP_TCP_CLIENT_OT_TP_SERVER) || \
	defined(CONFIG_WIFI_TP_TCP_SERVER_OT_TP_CLIENT) || \
	defined(CONFIG_WIFI_TP_TCP_SERVER_OT_TP_SERVER) || \
	defined(CONFIG_WIFI_CON_STABILITY_OT_TP_CLIENT_INTERFERENCE) || \
	defined(CONFIG_WIFI_CON_STABILITY_OT_TP_SERVER_INTERFERENCE) || \
	defined(CONFIG_WIFI_SHUTDOWN_OT_TP_CLIENT) || \
	defined(CONFIG_WIFI_SHUTDOWN_OT_TP_SERVER)

	#define ENABLE_OT_TRAFFIC_TEST

	K_THREAD_DEFINE(run_ot_traffic,
		CONFIG_WIFI_THREAD_STACK_SIZE,
		run_ot_benchmark,
		NULL,
		NULL,
		NULL,
		CONFIG_WIFI_THREAD_PRIORITY,
		0,
		K_TICKS_FOREVER);
#endif
	
#if defined(CONFIG_WIFI_SCAN_OT_DISCOV) || \
	defined(CONFIG_WIFI_CON_SCAN_OT_DISCOV) || \
	defined(CONFIG_WIFI_CON_OT_DISCOV) || \
	defined(CONFIG_WIFI_TP_UDP_CLIENT_OT_DISCOV) || \
	defined(CONFIG_WIFI_TP_UDP_SERVER_OT_DISCOV) || \
	defined(CONFIG_WIFI_TP_TCP_CLIENT_OT_DISCOV) || \
	defined(CONFIG_WIFI_TP_TCP_SERVER_OT_DISCOV) || \
	defined(CONFIG_WIFI_CON_STABILITY_OT_DISC_INTERFERENCE) || \
	defined(CONFIG_WIFI_SHUTDOWN_OT_DISCOV)

	#define ENABLE_OT_DISCOV_TEST

	K_THREAD_DEFINE(run_ot_discovery,
		CONFIG_WIFI_THREAD_STACK_SIZE,
		run_ot_discovery_test,
		NULL,
		NULL,
		NULL,
		CONFIG_WIFI_THREAD_PRIORITY,
		0,
		K_TICKS_FOREVER);
#endif

	
#if defined(CONFIG_WIFI_SCAN_OT_CONNECTION) || \
	defined(CONFIG_WIFI_CON_SCAN_OT_CONNECTION) || \
	defined(CONFIG_WIFI_TP_UDP_CLIENT_OT_CONNECTION) || \
	defined(CONFIG_WIFI_TP_UDP_SERVER_OT_CONNECTION) || \
	defined(CONFIG_WIFI_TP_TCP_CLIENT_OT_CONNECTION) || \
	defined(CONFIG_WIFI_TP_TCP_SERVER_OT_CONNECTION) || \
	defined(CONFIG_OT_CON_STABILITY_WIFI_SCAN_INTERFERENCE) || \
	defined(CONFIG_OT_CON_STABILITY_WIFI_CON_SCAN_INTERFERENCE) || \
	defined(CONFIG_OT_CON_STABILITY_WIFI_TP_UDP_CLIENT_INTERFERENCE) || \
	defined(CONFIG_OT_CON_STABILITY_WIFI_TP_UDP_SERVER_INTERFERENCE) || \
	defined(CONFIG_OT_CON_STABILITY_WIFI_TP_TCP_CLIENT_INTERFERENCE) || \
	defined(CONFIG_OT_CON_STABILITY_WIFI_TP_TCP_SERVER_INTERFERENCE) || \
	defined(CONFIG_WIFI_SHUTDOWN_OT_CONNECTION)

	#define ENABLE_OT_CONN_TEST

	K_THREAD_DEFINE(run_ot_connection,
		CONFIG_WIFI_THREAD_STACK_SIZE,
		run_ot_connection_test,
		NULL,
		NULL,
		NULL,
		CONFIG_WIFI_THREAD_PRIORITY,
		0,
		K_TICKS_FOREVER);
#endif

#if defined(CONFIG_WIFI_SCAN_OT_DISCOV) || \
	defined(CONFIG_WIFI_SCAN_OT_CONNECTION) || \
	defined(CONFIG_WIFI_SCAN_OT_TP_CLIENT) || \
	defined(CONFIG_WIFI_SCAN_OT_TP_SERVER) || \
	defined(CONFIG_WIFI_CON_SCAN_OT_DISCOV) || \
	defined(CONFIG_WIFI_CON_SCAN_OT_CONNECTION) || \
	defined(CONFIG_WIFI_CON_SCAN_OT_TP_CLIENT) || \
	defined(CONFIG_WIFI_CON_SCAN_OT_TP_SERVER)	|| \
	defined(CONFIG_OT_CON_STABILITY_WIFI_SCAN_INTERFERENCE) || \
	defined(CONFIG_OT_CON_STABILITY_WIFI_CON_SCAN_INTERFERENCE)

	#define ENABLE_WIFI_SCAN_TEST

	K_THREAD_DEFINE(run_wlan_scan,
		CONFIG_WIFI_THREAD_STACK_SIZE,
		run_wifi_scan_test,
		NULL,
		NULL,
		NULL,
		CONFIG_WIFI_THREAD_PRIORITY,
		0,
		K_TICKS_FOREVER);
#endif
	
#if defined(CONFIG_WIFI_CON_OT_DISCOV) ||\
	defined(CONFIG_WIFI_CON_OT_TP_CLIENT) ||\
	defined(CONFIG_WIFI_CON_OT_TP_SERVER)
	
	/* Note: dont use stability tests here */
	#define ENABLE_WIFI_CONN_TEST

	K_THREAD_DEFINE(run_wlan_conn,
		CONFIG_WIFI_THREAD_STACK_SIZE,
		run_wifi_conn_test,
		NULL,
		NULL,
		NULL,
		CONFIG_WIFI_THREAD_PRIORITY,
		0,
		K_TICKS_FOREVER);
#endif

/**
 * @brief Print Wi-Fi status
 *
 * @return Zero on success or (negative) error code otherwise.
 */
int cmd_wifi_status(void);
/**
 * @brief Initailise Wi-Fi arguments in variables
 *
 * @return Zero on success or (negative) error code otherwise.
 */
int __wifi_args_to_params(struct wifi_connect_req_params *params);
/**
 * @brief Request Wi-Fi connection
 *
 * @return Zero on success or (negative) error code otherwise.
 */
int wifi_connect(void);
/**
 * @brief Request Wi-Fi disconnection
 *
 * @return Zero on success or (negative) error code otherwise.
 */
int wifi_disconnect(void);
/**
 * @brief parse Wi-Fi IPv4 address
 *
 * @return Zero on success or (negative) error code otherwise.
 */
int parse_ipv4_addr(char *host, struct sockaddr_in *addr);
/**
 * @brief wait for next Wi-Fi event
 *
 * @return Zero on success or (negative) error code otherwise.
 */
int wait_for_next_event(const char *event_name, int timeout);
/**
 * @brief Callback for UDP download results
 *
 * @return Zero on success or (negative) error code otherwise.
 */
void udp_download_results_cb(enum zperf_status status,
							struct zperf_results *result,
							void *user_data);
/**
 * @brief Callback for UDP upload results
 *
 * @return Zero on success or (negative) error code otherwise.
 */
void udp_upload_results_cb(enum zperf_status status,
							struct zperf_results *result,
							void *user_data);
/**
 * @brief Callback for TCP download results
 *
 * @return Zero on success or (negative) error code otherwise.
 */
void tcp_download_results_cb(enum zperf_status status,
							struct zperf_results *result,
							void *user_data);
/**
 * @brief Callback for TCP upload results
 *
 * @return Zero on success or (negative) error code otherwise.
 */
void tcp_upload_results_cb(enum zperf_status status,
							struct zperf_results *result,
							void *user_data);
/**
 * @brief Run Wi-Fi scan test
 */
void wifi_scan_test_run(void);

/**
 * @brief Run Wi-Fi connection test
 */
void wifi_connection_test_run(void);

/**
 * @brief Start Thread advertisement
 *
 * @return None
 */
void adv_start(void);

/**
 * @brief Start Thread scan
 *
 * @return None
 */
void scan_start(void);

/**
 * @brief Callback for Wi-Fi DHCP IP addreds assigned
 *
 * @return No return value.
 */
void print_dhcp_ip(struct net_mgmt_event_callback *cb);
/**
 * @brief Print common test parameters info
 *
 * @return None
 */
void print_common_test_params(bool is_ant_mode_sep, bool test_thread, bool test_wifi,
	bool is_ot_client);
/**
 * @brief Print Thread connection test parameters info
 *
 * @return None
 */
void print_ot_connection_test_params(bool is_ot_client);

#ifdef CONFIG_TWT_ENABLE
	/**
	 * @brief Tear down TWT
	 *
	 * @return success/fail
	 */
	static int teardown_twt(void);

	/**
	 * @brief Wait for TWT response
	 *
	 * @return success/fail
	 */
	static int wait_for_twt_resp_received(void);

	/**
	 * @brief Setup TWT
	 *
	 * @return success/fail
	 */
	static int setup_twt(void);

	/**
	 * @brief Print TWT parameters
	 *
	 * @return None
	 */
	void print_twt_params(uint8_t dialog_token, uint8_t flow_id,
				     enum wifi_twt_negotiation_type negotiation_type,
				     bool responder, bool implicit, bool announce,
				     bool trigger, uint32_t twt_wake_interval,
				     uint64_t twt_interval);
#endif

#endif /* OT_COEX_FUNCTIONS_ */
```
